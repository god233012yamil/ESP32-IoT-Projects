#include <stdbool.h>
#include <stdint.h>

#include "app_event.h"
#include "button_input.h"
#include "climate_controller.h"
#include "event_queue.h"
#include "fake_temperature.h"
#include "freertos/FreeRTOS.h"
#include "freertos/task.h"
#include "logger.h"
#include "pwm_fan.h"

#define APP_TAG                       "APP"
#define APP_EVENT_QUEUE_LENGTH        16u
#define APP_TEMP_TASK_PERIOD_MS       1000u
#define APP_CONTROL_TASK_STACK_WORDS  4096u
#define APP_TEMP_TASK_STACK_WORDS     3072u
#define APP_CONTROL_TASK_PRIORITY     5u
#define APP_TEMP_TASK_PRIORITY        4u
#define APP_FAN_ON_THRESHOLD_C        40
#define APP_FAN_OFF_THRESHOLD_C       35

static event_queue_t s_event_queue;
static climate_controller_t s_climate_controller;
static bool s_previous_fan_state = false;

/**
 * @brief Forwards button events from the input module to the application queue.
 *
 * Args:
 *     event: Button event generated by the input module.
 *     context: Pointer to the application event queue.
 */
static void app_button_event_callback(app_event_t event, void *context)
{
    BaseType_t higher_priority_task_woken = pdFALSE;
    event_queue_t *queue = (event_queue_t *)context;

    (void)event_queue_push_from_isr(queue, &event, &higher_priority_task_woken);

    if (higher_priority_task_woken == pdTRUE)
    {
        portYIELD_FROM_ISR();
    }
}

/**
 * @brief Publishes periodic temperature samples to the application event queue.
 *
 * Args:
 *     argument: Pointer to the application event queue.
 */
static void temperature_task(void *argument)
{
    event_queue_t *queue = (event_queue_t *)argument;

    while (true)
    {
        int16_t temperature_c = 0;

        fake_temperature_update();

        if (fake_temperature_source.read_celsius(&temperature_c))
        {
            app_event_t event =
            {
                .type = APP_EVENT_TEMPERATURE_SAMPLE,
                .data.temperature_c = temperature_c
            };

            (void)event_queue_push(queue, &event, pdMS_TO_TICKS(50));
        }

        vTaskDelay(pdMS_TO_TICKS(APP_TEMP_TASK_PERIOD_MS));
    }
}

/**
 * @brief Processes application events and updates loosely coupled services.
 *
 * Args:
 *     argument: Pointer to the application event queue.
 */
static void control_task(void *argument)
{
    event_queue_t *queue = (event_queue_t *)argument;
    app_event_t event;

    while (true)
    {
        if (event_queue_pop(queue, &event, portMAX_DELAY))
        {
            switch (event.type)
            {
                case APP_EVENT_TEMPERATURE_SAMPLE:
                {
                    uint8_t fan_percent = climate_controller_update(&s_climate_controller,
                                                                     event.data.temperature_c);
                    bool fan_state = climate_controller_is_fan_enabled(&s_climate_controller);

                    logger_infof(APP_TAG,
                                 "temperature=%d C, fan=%u percent",
                                 event.data.temperature_c,
                                 fan_percent);

                    if (fan_state != s_previous_fan_state)
                    {
                        s_previous_fan_state = fan_state;
                        logger_info(APP_TAG, fan_state ? "fan state changed to ON" : "fan state changed to OFF");
                    }
                    break;
                }

                case APP_EVENT_BUTTON_PRESSED:
                    logger_info(APP_TAG, "button pressed event received");
                    break;

                case APP_EVENT_BUTTON_RELEASED:
                    logger_info(APP_TAG, "button released event received");
                    break;

                default:
                    break;
            }
        }
    }
}

/**
 * @brief Application entry point.
 */
void app_main(void)
{
    // Initialize logger and print startup message
    logger_init();
    logger_info(APP_TAG, "ESP32-S3 loose coupling demo started");

    // Initialize the application event queue
    if (!event_queue_init(&s_event_queue, APP_EVENT_QUEUE_LENGTH))
    {
        logger_info(APP_TAG, "failed to create event queue");
        return;
    }

    // Initialize the fake temperature source with an initial temperature of 25 C
    fake_temperature_init(25);
    
    // Initialize the PWM fan output and climate controller
    pwm_fan_init();

    climate_controller_init(&s_climate_controller,
                            &fake_temperature_source,
                            &pwm_fan_output,
                            APP_FAN_ON_THRESHOLD_C,
                            APP_FAN_OFF_THRESHOLD_C);

    // Register the button event callback and initialize the button input module
    button_input_register_callback(app_button_event_callback, &s_event_queue);
    button_input_init();

    // Create the control and temperature tasks
    (void)xTaskCreate(control_task,
                      "control_task",
                      APP_CONTROL_TASK_STACK_WORDS,
                      &s_event_queue,
                      APP_CONTROL_TASK_PRIORITY,
                      0);

    // Create the temperature task
    (void)xTaskCreate(temperature_task,
                      "temperature_task",
                      APP_TEMP_TASK_STACK_WORDS,
                      &s_event_queue,
                      APP_TEMP_TASK_PRIORITY,
                      0);
}
