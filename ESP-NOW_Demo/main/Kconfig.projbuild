## ESP-NOW_Demo/main/Kconfig.projbuild
```kconfig
menu "ESP-NOW Beginner Demo"

config ESPNOW_ROLE_SENDER
    bool "Build as Sender (transmitter)"
    default y
    help
        If enabled, the firmware sends a small packet every second to the peer MAC.

config ESPNOW_ROLE_RECEIVER
    bool "Build as Receiver (gateway)"
    default n
    depends on !ESPNOW_ROLE_SENDER
    help
        If enabled, the firmware receives ESP-NOW packets and prints them.

config ESPNOW_CHANNEL
    int "ESP-NOW Wi-Fi channel (1-13)"
    range 1 13
    default 1
    help
        Both devices must use the same channel for ESP-NOW.

config ESPNOW_PEER_MAC
    string "Peer MAC address (format: AA:BB:CC:DD:EE:FF)"
    default "FF:FF:FF:FF:FF:FF"
    help
        Destination MAC used by the sender.
        Use FF:FF:FF:FF:FF:FF for broadcast (no pairing needed).

endmenu
```

## ESP-NOW_Demo/sdkconfig.defaults
```kconfig
# Beginner-friendly defaults (can be overridden in menuconfig)

# Increase log level to INFO by default
CONFIG_LOG_DEFAULT_LEVEL_INFO=y
CONFIG_LOG_DEFAULT_LEVEL=3

# Make sure Wi-Fi is enabled
CONFIG_ESP_WIFI_ENABLED=y
```

## ESP32C6 Touch LCD 1.47 WiFi Internet Clock/sdkconfig.defaults
```kconfig
# Target configuration
CONFIG_IDF_TARGET="esp32c6"

# FreeRTOS
CONFIG_FREERTOS_HZ=1000

# SPI Configuration
CONFIG_SPI_MASTER_IN_IRAM=y

# WiFi Configuration
CONFIG_ESP_WIFI_STATIC_RX_BUFFER_NUM=10
CONFIG_ESP_WIFI_DYNAMIC_RX_BUFFER_NUM=32
CONFIG_ESP_WIFI_DYNAMIC_TX_BUFFER_NUM=32
CONFIG_ESP_WIFI_AMPDU_TX_ENABLED=y
CONFIG_ESP_WIFI_AMPDU_RX_ENABLED=y

# LWIP Configuration
CONFIG_LWIP_MAX_SOCKETS=10
CONFIG_LWIP_SO_REUSE=y
CONFIG_LWIP_SO_RCVBUF=y

# SNTP Configuration
CONFIG_LWIP_SNTP_UPDATE_DELAY=3600000

# CPU Configuration
CONFIG_ESP_DEFAULT_CPU_FREQ_MHZ_160=y

# Log Configuration
CONFIG_LOG_DEFAULT_LEVEL_INFO=y
```

## ESP32C6_Power_Gating_Demo/main/Kconfig.projbuild
```kconfig
menu "Power Gating Demo"

choice PG_TECHNIQUE
    prompt "Power gating technique"
    default PG_TECH_REG_EN
    help
        Select the hardware technique used to gate an external rail.

config PG_TECH_REG_EN
    bool "Regulator EN pin (GPIO -> EN)"

config PG_TECH_LOAD_SWITCH
    bool "Load switch (GPIO -> load switch EN)"

config PG_TECH_PFET_DRIVER
    bool "PFET high-side with driver (GPIO -> gate driver EN)"

endchoice

config PG_ENABLE_GPIO
    int "Enable GPIO (controls EN / load switch / driver)"
    default 10
    range 0 30

config PG_ACTIVE_HIGH
    bool "Enable is active high"
    default y

config PG_STABILIZE_MS
    int "Rail stabilize delay (ms)"
    default 5
    range 0 1000

config PG_WAKE_INTERVAL_S
    int "Wake interval (seconds)"
    default 60
    range 1 86400

config PG_BUS_I2C_SCL_GPIO
    int "I2C SCL GPIO (bus safe state)"
    default 8
    range 0 30

config PG_BUS_I2C_SDA_GPIO
    int "I2C SDA GPIO (bus safe state)"
    default 9
    range 0 30

config PG_LOG_SAMPLE
    bool "Log sample value each cycle"
    default y

endmenu
```

## ESP32C6_Power_Gating_Demo/sdkconfig.defaults
```kconfig
# Defaults intended for ESP32-C6 power gating demo.
CONFIG_FREERTOS_HZ=1000
CONFIG_LOG_DEFAULT_LEVEL_INFO=y
CONFIG_ESP_SYSTEM_PANIC_PRINT_REBOOT=y
```

## ESP32C6_Secure_Boot_Https_Ota_Ref/main/Kconfig.projbuild
```kconfig
menu "Secure OTA Reference (app settings)"

config APP_WIFI_SSID
    string "Wi-Fi SSID"
    default ""

config APP_WIFI_PASSWORD
    string "Wi-Fi password"
    default ""

config APP_OTA_FIRMWARE_URL
    string "HTTPS firmware URL"
    default "https://example.com/firmware/esp32c6_secure_boot_https_ota_ref.bin"

config APP_OTA_TRIGGER_URL
    string "HTTPS trigger URL (optional)"
    default ""

config APP_OTA_ALLOW_WITHOUT_TIME
    bool "Allow OTA if time is not synced"
    default y

config APP_OTA_MAINT_START_HOUR
    int "Maintenance window start hour (0-23)"
    default 2

config APP_OTA_MAINT_END_HOUR
    int "Maintenance window end hour (0-23)"
    default 5

config APP_BATT_MIN_MV
    int "Minimum battery level (mV) required to start OTA"
    default 3600

config APP_BATT_FAKE_MV
    int "Battery level used by the demo (mV)"
    default 4200

config APP_OTA_BUTTON_GPIO
    int "GPIO for OTA button (active-low with pull-up)"
    default 9

config APP_OTA_POLL_PERIOD_MS
    int "OTA decision loop period (ms)"
    default 2000

endmenu
```

## ESP32C6_Secure_Boot_Https_Ota_Ref/sdkconfig.defaults
```kconfig
CONFIG_IDF_TARGET="esp32c6"
CONFIG_LOG_DEFAULT_LEVEL_INFO=y

CONFIG_PARTITION_TABLE_OFFSET=0x10000
CONFIG_PARTITION_TABLE_CUSTOM=y
CONFIG_PARTITION_TABLE_CUSTOM_FILENAME="partitions.csv"

CONFIG_SECURE_BOOT=y
CONFIG_SECURE_BOOT_V2_ENABLED=y
CONFIG_SECURE_BOOT_SIGNING_KEY="secure_boot_signing_key.pem"

CONFIG_BOOTLOADER_APP_ROLLBACK_ENABLE=y
CONFIG_BOOTLOADER_APP_ANTI_ROLLBACK=y

CONFIG_SECURE_FLASH_ENC_ENABLED=n

# TLS bundle (useful fallback; pinning still uses cert_pem)
CONFIG_MBEDTLS_CERTIFICATE_BUNDLE=y
CONFIG_ESP_TLS_INSECURE=n

# Flash Size = 8MB
CONFIG_ESPTOOLPY_FLASHSIZE_8MB=y
CONFIG_ESPTOOLPY_FLASHSIZE="8MB"
```

## ESP32C6_Secure_Boot_Https_Ota_Ref/sdkconfig.defaults.production
```kconfig
CONFIG_IDF_TARGET="esp32c6"
CONFIG_LOG_DEFAULT_LEVEL_INFO=y

CONFIG_PARTITION_TABLE_OFFSET=0x10000
CONFIG_PARTITION_TABLE_CUSTOM=y
CONFIG_PARTITION_TABLE_CUSTOM_FILENAME="partitions.csv"

CONFIG_SECURE_BOOT=y
CONFIG_SECURE_BOOT_V2_ENABLED=y

CONFIG_BOOTLOADER_APP_ROLLBACK_ENABLE=y
CONFIG_BOOTLOADER_APP_ANTI_ROLLBACK=y

CONFIG_SECURE_FLASH_ENC_ENABLED=y
```

## ESP32S3_Custom_Efuse_Gen_Demo/main/Kconfig.projbuild
```kconfig
menu "Custom eFuse Demo"

config DEMO_PROGRAM_EFUSE
    bool "Program custom eFuse fields on boot"
    default y
    help
        If enabled, the demo will attempt to burn the custom fields on boot.
        This is irreversible when virtual eFuses are disabled.

endmenu
```

## ESP32S3_Custom_Efuse_Gen_Demo/sdkconfig.defaults
```kconfig
# Demo defaults: keep virtual eFuses enabled to avoid permanent burns while testing.
CONFIG_EFUSE_VIRTUAL=y
CONFIG_EFUSE_VIRTUAL_KEEP_IN_FLASH=y

# Virtual eFuses stored in flash require an "efuse" data partition.
# This project uses a custom partition table that includes it.
CONFIG_PARTITION_TABLE_CUSTOM=y
CONFIG_PARTITION_TABLE_CUSTOM_FILENAME="partitions.csv"

# More console output.
CONFIG_LOG_DEFAULT_LEVEL_INFO=y
```

## ESP32S3_LittleFS_Demo/sdkconfig.defaults
```kconfig
# LittleFS demo defaults
CONFIG_PARTITION_TABLE_CUSTOM=y
CONFIG_PARTITION_TABLE_CUSTOM_FILENAME="partitions.csv"

# Enable LittleFS (config symbol names vary slightly across ESP-IDF releases)
CONFIG_LITTLEFS_ENABLED=y
CONFIG_LITTLEFS_PAGE_SIZE=256
CONFIG_LITTLEFS_OBJ_NAME_LEN=64
CONFIG_LITTLEFS_READ_SIZE=128
CONFIG_LITTLEFS_WRITE_SIZE=128
CONFIG_LITTLEFS_CACHE_SIZE=512
CONFIG_LITTLEFS_LOOKAHEAD_SIZE=128
CONFIG_LITTLEFS_USE_MTIME=y
CONFIG_LITTLEFS_ENABLE_FALLOCATE=y
CONFIG_LITTLEFS_MAX_PARTITIONS=3
```

## ESP32_FreeRTOS_SMP_IPC_Demo/main/Kconfig.projbuild
```kconfig
menu "SMP IPC Demo"
    choice SMP_IPC_DEMO_MODE
        prompt "Demo mode"
        default SMP_IPC_DEMO_MODE_QUEUE
        help
            Select which inter-core IPC demo runs in app_main().

        config SMP_IPC_DEMO_MODE_QUEUE
            bool "Queue (payload passing)"

        config SMP_IPC_DEMO_MODE_NOTIFY
            bool "Task notifications (signaling)"
    endchoice

    config SMP_IPC_PRODUCER_CORE
        int "Producer core ID"
        range 0 1
        default 0
        help
            Core ID used for producer task pinning.

    config SMP_IPC_CONSUMER_CORE
        int "Consumer core ID"
        range 0 1
        default 1
        help
            Core ID used for consumer task pinning.
endmenu
```

## ESP32_FreeRTOS_SMP_IPC_Demo/sdkconfig.defaults
```kconfig
CONFIG_LOG_DEFAULT_LEVEL_INFO=y
# MCU target
CONFIG_IDF_TARGET="esp32s3"
# Flash size
CONFIG_ESPTOOLPY_FLASHSIZE_8MB=y
```

## ESP32_Low_Power_Reference/main/Kconfig.projbuild
```kconfig
menu "Low-Power Reference Project"

config LP_REPORT_PERIOD_SEC
    int "Report period in seconds (deep sleep timer)"
    range 5 86400
    default 300
    help
        The device wakes up on this timer, performs a short work burst, then
        returns to deep sleep.

config LP_ENABLE_GPIO_WAKE
    bool "Enable GPIO wake (EXT0)"
    default y
    help
        Enables wakeup via an external GPIO using EXT0.

config LP_WAKE_GPIO
    int "Wake GPIO number"
    default 0
    depends on LP_ENABLE_GPIO_WAKE
    help
        GPIO used for EXT0 wake. Common dev boards use GPIO0 (BOOT button).

config LP_WAKE_LEVEL
    int "Wake level (0 or 1)"
    range 0 1
    default 0
    depends on LP_ENABLE_GPIO_WAKE
    help
        EXT0 wake triggers when the RTC GPIO matches this level.

config LP_ENABLE_WIFI
    bool "Enable Wi-Fi connect/transmit/disconnect demo"
    default n
    help
        If enabled, the firmware will connect to Wi-Fi, perform a minimal
        TCP transaction, then shut Wi-Fi down before sleeping.

if LP_ENABLE_WIFI

config LP_WIFI_SSID
    string "Wi-Fi SSID"
    default "your_ssid"

config LP_WIFI_PASSWORD
    string "Wi-Fi Password"
    default "your_password"

config LP_WIFI_CONNECT_TIMEOUT_MS
    int "Wi-Fi connect timeout (ms)"
    range 1000 60000
    default 15000

config LP_WIFI_TX_HOST
    string "Demo host to connect"
    default "example.com"

config LP_WIFI_TX_PORT
    int "Demo port"
    range 1 65535
    default 80

endif

endmenu
```

## ESP32_Low_Power_Reference/sdkconfig.defaults
```kconfig
# Reasonable defaults for a low-power reference project.
# You can override anything via menuconfig.

CONFIG_FREERTOS_HZ=100
CONFIG_LOG_DEFAULT_LEVEL_WARN=y
CONFIG_LOG_DEFAULT_LEVEL=2

# Enable power management framework (required for DFS/light sleep integration).
CONFIG_PM_ENABLE=y

# Reduce console noise in production-like builds.
CONFIG_ESP_CONSOLE_USB_SERIAL_JTAG_ENABLED=n
```

## ESP32_Uart_Event_Ref/sdkconfig.defaults
```kconfig
# Optional defaults for this project.
# You can adjust logging verbosity here if desired.

CONFIG_LOG_DEFAULT_LEVEL_INFO=y
CONFIG_LOG_MAXIMUM_LEVEL_INFO=y
```

## Preemptive_vs_Non_Preemptive_Scheduling_Demo/main/Kconfig.projbuild
```kconfig
menu "Scheduling Model Demo"

choice DEMO_MODE
    prompt "Demo mode"
    default DEMO_MODE_PREEMPTIVE
    help
        Select which execution model is demonstrated.

config DEMO_MODE_PREEMPTIVE
    bool "Preemptive (FreeRTOS tasks)"
    help
        Demonstrates preemptive scheduling with multiple tasks and priorities.

config DEMO_MODE_COOPERATIVE
    bool "Cooperative (run-to-completion event loop)"
    help
        Demonstrates a cooperative, run-to-completion event loop in a single task.
endchoice

config COOP_EVENT_QUEUE_LEN
    int "Cooperative event queue length"
    range 4 64
    default 16
    depends on DEMO_MODE_COOPERATIVE

config COOP_TIMER_PERIOD_MS
    int "Cooperative timer period (ms)"
    range 50 5000
    default 250
    depends on DEMO_MODE_COOPERATIVE

endmenu
```

## Semaphore_Mutex_Demo/sdkconfig.defaults
```kconfig
# Keep logs readable
CONFIG_LOG_DEFAULT_LEVEL_INFO=y

# FreeRTOS tick rate (default is usually fine; kept explicit for demos)
CONFIG_FREERTOS_HZ=1000

# Enable GPIO ISR service (driver uses it)
CONFIG_GPIO_ISR_HANDLER_IN_IRAM=y
```

## Task_Synchronization_Using_Event_Groups_Demo/sdkconfig.defaults
```kconfig
# Keep logs visible during demo
CONFIG_LOG_DEFAULT_LEVEL_INFO=y
CONFIG_LOG_MAXIMUM_LEVEL_INFO=y
```

## USB_HID_Keyboard/sdkconfig.defaults
```kconfig
# Console on UART0 @ 115200 (COM port)
CONFIG_ESP_CONSOLE_UART=y
CONFIG_ESP_CONSOLE_UART_DEFAULT=y
CONFIG_ESP_CONSOLE_USB_CDC=n
CONFIG_ESP_CONSOLE_USB_SERIAL_JTAG=n
CONFIG_ESP_CONSOLE_UART_NUM=0
CONFIG_ESP_CONSOLE_UART_BAUDRATE=115200

# TinyUSB Device (HID keyboard)
CONFIG_TINYUSB_ENABLED=y
CONFIG_TINYUSB_DEVICE_ENABLED=y
CONFIG_TINYUSB_HID_ENABLED=y
CONFIG_TINYUSB_HID_COUNT=1
# Keep it simple: HID-only for now
CONFIG_TINYUSB_CDC_ENABLED=n

# ESP32-S3 internal USB PHY and default pins
CONFIG_TINYUSB_USBDEV_ENABLED=y
CONFIG_USB_OTG_SUPPORTED=y
CONFIG_TINYUSB_INTERNAL_PHY=y
CONFIG_TINYUSB_DPLUS=20
CONFIG_TINYUSB_DMINUS=19
```

## esp32_dth11_thingsboard_project/sdkconfig.defaults
```kconfig
# Target configuration
CONFIG_IDF_TARGET="esp32s3"

# WiFi configuration
CONFIG_ESP_WIFI_SSID=""
CONFIG_ESP_WIFI_PASSWORD=""

# FreeRTOS configuration
CONFIG_FREERTOS_HZ=1000

# Log configuration
CONFIG_LOG_DEFAULT_LEVEL_INFO=y

# MQTT configuration
CONFIG_MQTT_PROTOCOL_311=y

# Network configuration
CONFIG_LWIP_MAX_SOCKETS=10
```

## esp32_i2c_devices_demo/main/Kconfig.projbuild
```kconfig
menu "ESP32 I2C Devices Demo Configuration"

config APP_I2C_PORT
    int "I2C controller port"
    range 0 1
    default 0
    help
        Hardware I2C controller used by the application.

config APP_I2C_SDA_GPIO
    int "SDA GPIO"
    range 0 48
    default 21
    help
        GPIO used for the I2C SDA signal. Verify the selected GPIO is valid
        for the target ESP32 board.

config APP_I2C_SCL_GPIO
    int "SCL GPIO"
    range 0 48
    default 22
    help
        GPIO used for the I2C SCL signal. Verify the selected GPIO is valid
        for the target ESP32 board.

config APP_I2C_CLOCK_HZ
    int "I2C clock frequency"
    range 10000 1000000
    default 100000
    help
        I2C bus clock frequency in hertz. Start with 100000 Hz and increase
        only when every connected device and the physical bus support it.

config APP_I2C_ENABLE_INTERNAL_PULLUPS
    bool "Enable ESP32 internal pull-up resistors"
    default y
    help
        Enables the weak internal GPIO pull-ups. External pull-up resistors
        are still recommended for reliable hardware.

config APP_ENABLE_TMP102_DEMO
    bool "Enable TMP102 temperature sensor demo"
    default y

config APP_TMP102_ADDRESS
    hex "TMP102 I2C address"
    range 0x08 0x77
    default 0x48
    depends on APP_ENABLE_TMP102_DEMO

config APP_ENABLE_SSD1306_DEMO
    bool "Enable SSD1306 OLED display demo"
    default y

config APP_SSD1306_ADDRESS
    hex "SSD1306 I2C address"
    range 0x08 0x77
    default 0x3C
    depends on APP_ENABLE_SSD1306_DEMO

config APP_ENABLE_EEPROM_DEMO
    bool "Enable 24LC256 EEPROM demo"
    default y

config APP_EEPROM_ADDRESS
    hex "24LC256 I2C address"
    range 0x08 0x77
    default 0x50
    depends on APP_ENABLE_EEPROM_DEMO

config APP_EEPROM_TEST_ADDRESS
    hex "EEPROM test memory address"
    range 0x0000 0x7FFF
    default 0x0100
    depends on APP_ENABLE_EEPROM_DEMO
    help
        EEPROM location used by the non-destructive demonstration. The demo
        saves the original bytes, writes a test pattern, verifies it, and then
        restores the original bytes.

endmenu
```

## esp32_pwm_ledc_demo/main/Kconfig.projbuild
```kconfig
menu "ESP32 PWM LEDC Demo Configuration"

    config PWM_DEMO_LED_GPIO
        int "LED PWM GPIO"
        default 2
        help
            GPIO used to demonstrate LED brightness control with PWM.

    config PWM_DEMO_MOTOR_GPIO
        int "Motor driver PWM GPIO"
        default 18
        help
            GPIO used to demonstrate DC motor speed control through an external driver.

    config PWM_DEMO_BUZZER_GPIO
        int "Passive buzzer PWM GPIO"
        default 19
        help
            GPIO used to demonstrate passive buzzer tone generation.

    config PWM_DEMO_SERVO_GPIO
        int "Servo signal GPIO"
        default 21
        help
            GPIO used to demonstrate servo-style pulse generation.

    config PWM_DEMO_ENABLE_MOTOR
        bool "Enable motor speed demo"
        default y
        help
            Enables the motor PWM demonstration. Use an external motor driver.

    config PWM_DEMO_ENABLE_BUZZER
        bool "Enable buzzer tone demo"
        default y
        help
            Enables the passive buzzer tone demonstration.

    config PWM_DEMO_ENABLE_SERVO
        bool "Enable servo-style signal demo"
        default y
        help
            Enables the servo-style pulse demonstration. Use an external servo supply.

endmenu
```
