## esp32_uart_beginner/main/Kconfig.projbuild
```kconfig
menu "UART Beginner Example Configuration"

config APP_UART_PORT_NUM
    int "UART controller number"
    range 1 2
    default 1
    help
        Select the hardware UART controller used by the example. UART0 is
        intentionally avoided because it is normally used by the ESP-IDF
        console and flashing interface.

config APP_UART_TX_PIN
    int "UART TX GPIO"
    range 0 48
    default 17
    help
        GPIO used to transmit data to the external UART device.

config APP_UART_RX_PIN
    int "UART RX GPIO"
    range 0 48
    default 16
    help
        GPIO used to receive data from the external UART device.

config APP_UART_BAUD_RATE
    int "UART baud rate"
    range 1200 2000000
    default 115200
    help
        Baud rate shared by the ESP32 and the external UART device.

config APP_UART_RX_BUFFER_SIZE
    int "UART RX ring buffer size"
    range 256 8192
    default 1024
    help
        Size, in bytes, of the UART driver's receive ring buffer.

config APP_UART_TX_BUFFER_SIZE
    int "UART TX ring buffer size"
    range 0 8192
    default 1024
    help
        Size, in bytes, of the UART driver's transmit ring buffer.

endmenu
```

## esp32_uart_beginner/sdkconfig.defaults
```kconfig
CONFIG_APP_UART_PORT_NUM=1
CONFIG_APP_UART_TX_PIN=17
CONFIG_APP_UART_RX_PIN=16
CONFIG_APP_UART_BAUD_RATE=115200
CONFIG_APP_UART_RX_BUFFER_SIZE=1024
CONFIG_APP_UART_TX_BUFFER_SIZE=1024
```

## esp32s3_ble_long_range/sdkconfig.defaults
```kconfig
CONFIG_IDF_TARGET="esp32s3"
CONFIG_BT_ENABLED=y
CONFIG_BT_BLUEDROID_ENABLED=y
CONFIG_BT_BLE_50_FEATURES_SUPPORTED=y
CONFIG_BT_BLE_42_FEATURES_SUPPORTED=y
CONFIG_BT_BLE_DYNAMIC_ENV_MEMORY=y
CONFIG_BTDM_CTRL_MODE_BLE_ONLY=y
CONFIG_BTDM_CTRL_BLE_MAX_CONN=1
CONFIG_COMPILER_OPTIMIZATION_PERF=y
CONFIG_LOG_DEFAULT_LEVEL_INFO=y
CONFIG_PARTITION_TABLE_SINGLE_APP=y
```

## esp32s3_context_switch_demo/main/Kconfig.projbuild
```kconfig
menu "Context Switch Demo"

config DEMO_GPIO_CONTROL_TRACE
    int "Control task trace GPIO"
    default 2
    help
        GPIO driven high while the high-priority control task is executing.

config DEMO_GPIO_COMMS_TRACE
    int "Communication task trace GPIO"
    default 4
    help
        GPIO toggled by the communication producer task.

config DEMO_GPIO_BACKGROUND_TRACE
    int "Background task trace GPIO"
    default 5
    help
        GPIO toggled by the low-priority background task.

config DEMO_CONTROL_PERIOD_US
    int "Control task period in microseconds"
    default 10000
    range 1000 1000000
    help
        Period of the hardware timer interrupt that wakes the control task.

endmenu
```

## esp32s3_context_switch_demo/sdkconfig.defaults
```kconfig
CONFIG_IDF_TARGET="esp32s3"
CONFIG_FREERTOS_HZ=1000
CONFIG_LOG_DEFAULT_LEVEL_INFO=y
CONFIG_ESP_MAIN_TASK_STACK_SIZE=4096
CONFIG_COMPILER_OPTIMIZATION_PERF=y
```

## esp32s3_digital_scale/sdkconfig.defaults
```kconfig
# sdkconfig.defaults – ESP32-S3 Digital Scale
# These values are applied when "idf.py reconfigure" or "idf.py menuconfig"
# is run for the first time.  Committed values override ESP-IDF defaults;
# user-specific secrets (SSID/password) should be set in scale_config.h or
# via "idf.py menuconfig" and NOT committed to source control.

# ── Target ────────────────────────────────────────────────────────────────────
CONFIG_IDF_TARGET="esp32s3"

# ── Flash ─────────────────────────────────────────────────────────────────────
CONFIG_ESPTOOLPY_FLASHSIZE_4MB=y
CONFIG_PARTITION_TABLE_SINGLE_APP=y

# ── Wi-Fi ─────────────────────────────────────────────────────────────────────
CONFIG_ESP_WIFI_STATIC_RX_BUFFER_NUM=10
CONFIG_ESP_WIFI_DYNAMIC_RX_BUFFER_NUM=32
CONFIG_ESP_WIFI_STATIC_TX_BUFFER=y
CONFIG_ESP_WIFI_TX_BUFFER_TYPE=0
CONFIG_ESP_WIFI_STATIC_TX_BUFFER_NUM=16
CONFIG_ESP_WIFI_CACHE_TX_BUFFER_NUM=32

# ── TCP/IP ────────────────────────────────────────────────────────────────────
CONFIG_LWIP_MAX_SOCKETS=16
CONFIG_LWIP_SOCKET_SELECT_TIMEOUT=y
CONFIG_LWIP_TCP_KEEPALIVE=y

# ── HTTP Server ───────────────────────────────────────────────────────────────
CONFIG_HTTPD_MAX_REQ_HDR_LEN=1024
CONFIG_HTTPD_MAX_URI_LEN=512
CONFIG_HTTPD_ERR_RESP_NO_DELAY=y
CONFIG_HTTPD_PURGE_CONNECTIONS=y

# ── FreeRTOS ──────────────────────────────────────────────────────────────────
CONFIG_FREERTOS_HZ=1000
CONFIG_FREERTOS_USE_TRACE_FACILITY=y

# ── Log level ─────────────────────────────────────────────────────────────────
CONFIG_LOG_DEFAULT_LEVEL_INFO=y
CONFIG_LOG_MAXIMUM_LEVEL_DEBUG=y

# ── NVS ───────────────────────────────────────────────────────────────────────
CONFIG_NVS_ENCRYPTION=n

# ── UART Console ──────────────────────────────────────────────────────────────
CONFIG_ESP_CONSOLE_UART_DEFAULT=y
CONFIG_ESP_CONSOLE_UART_BAUDRATE=115200

# ── cJSON ─────────────────────────────────────────────────────────────────────
CONFIG_CJSON_ENABLE=y
```

## esp32s3_espnow_low_power_mesh/main/Kconfig.projbuild
```kconfig
menu "ESP-NOW Low-Power Mesh Configuration"

choice APP_NODE_ROLE
    prompt "Node role"
    default APP_ROLE_LEAF

    config APP_ROLE_ROOT
        bool "Root gateway (always awake)"

    config APP_ROLE_ROUTER
        bool "Router node (always awake)"

    config APP_ROLE_LEAF
        bool "Leaf sensor node (deep sleep)"
endchoice

config APP_NODE_ID
    int "Logical node ID"
    range 1 65535
    default 1

config APP_PARENT_MAC
    string "Parent MAC address (AA:BB:CC:DD:EE:FF)"
    default "FF:FF:FF:FF:FF:FF"
    help
        Used by router and leaf roles. Use the upstream router or root MAC.

config APP_WIFI_CHANNEL
    int "ESP-NOW Wi-Fi channel"
    range 1 13
    default 1

config APP_WAKE_INTERVAL_SEC
    int "Leaf wake interval in seconds"
    range 5 86400
    default 60

config APP_BEACON_INTERVAL_MS
    int "Root synchronization beacon interval in milliseconds"
    range 100 60000
    default 1000

config APP_BEACON_WAIT_MS
    int "Leaf beacon wait window in milliseconds"
    range 50 5000
    default 600

config APP_ACK_TIMEOUT_MS
    int "ACK timeout in milliseconds"
    range 10 2000
    default 120

config APP_MAX_RETRIES
    int "Maximum packet retries"
    range 0 10
    default 3

config APP_FORWARD_TTL
    int "Initial mesh packet TTL"
    range 1 32
    default 6

config APP_ENABLE_ENCRYPTION
    bool "Enable ESP-NOW peer encryption"
    default n

config APP_PMK
    string "ESP-NOW PMK (16 ASCII characters)"
    default "pmk1234567890123"
    depends on APP_ENABLE_ENCRYPTION

config APP_LMK
    string "ESP-NOW LMK (16 ASCII characters)"
    default "lmk1234567890123"
    depends on APP_ENABLE_ENCRYPTION

endmenu
```

## esp32s3_espnow_low_power_mesh/sdkconfig.defaults
```kconfig
CONFIG_IDF_TARGET="esp32s3"
CONFIG_ESPTOOLPY_FLASHSIZE_8MB=y
CONFIG_ESPTOOLPY_FLASHSIZE="8MB"
CONFIG_FREERTOS_HZ=1000
CONFIG_LOG_DEFAULT_LEVEL_INFO=y
```

## esp32s3_hw_crypto_demo/sdkconfig.defaults
```kconfig
CONFIG_IDF_TARGET="esp32s3"
CONFIG_MBEDTLS_HARDWARE_AES=y
CONFIG_MBEDTLS_HARDWARE_SHA=y
CONFIG_ESP_DEFAULT_CPU_FREQ_MHZ_240=y
CONFIG_ESP_DEFAULT_CPU_FREQ_MHZ=240
CONFIG_COMPILER_OPTIMIZATION_PERF=y
CONFIG_LOG_DEFAULT_LEVEL_INFO=y
```

## esp32s3_loose_coupling_demo/sdkconfig.defaults
```kconfig
CONFIG_IDF_TARGET="esp32s3"
CONFIG_ESPTOOLPY_FLASHSIZE_8MB=y
CONFIG_ESPTOOLPY_FLASHSIZE="8MB"
CONFIG_ESP_CONSOLE_UART_DEFAULT=y
CONFIG_ESP_CONSOLE_UART_BAUDRATE=115200
CONFIG_FREERTOS_HZ=1000
```

## esp32s3_multicore_realtime_scheduler/sdkconfig.defaults
```kconfig
CONFIG_IDF_TARGET="esp32s3"
CONFIG_FREERTOS_HZ=1000
CONFIG_FREERTOS_USE_TRACE_FACILITY=y
CONFIG_FREERTOS_GENERATE_RUN_TIME_STATS=y
CONFIG_FREERTOS_USE_STATS_FORMATTING_FUNCTIONS=y
CONFIG_ESP_TASK_WDT_EN=y
CONFIG_ESP_TASK_WDT_INIT=y
CONFIG_ESP_TASK_WDT_TIMEOUT_S=5
CONFIG_ESP_TASK_WDT_CHECK_IDLE_TASK_CPU0=y
CONFIG_ESP_TASK_WDT_CHECK_IDLE_TASK_CPU1=y
CONFIG_LOG_DEFAULT_LEVEL_INFO=y
```

## esp32s3_pid_controller_demo/sdkconfig.defaults
```kconfig
CONFIG_IDF_TARGET="esp32s3"
CONFIG_ESPTOOLPY_FLASHSIZE_8MB=y
CONFIG_ESPTOOLPY_FLASHSIZE="8MB"
CONFIG_ESP_CONSOLE_UART_BAUDRATE=115200
CONFIG_FREERTOS_HZ=1000
CONFIG_LOG_DEFAULT_LEVEL_INFO=y
```

## esp32s3_production_pid_demo/sdkconfig.defaults
```kconfig
CONFIG_IDF_TARGET="esp32s3"
CONFIG_ESPTOOLPY_FLASHSIZE_8MB=y
CONFIG_ESP_MAIN_TASK_STACK_SIZE=4096
CONFIG_FREERTOS_HZ=1000
CONFIG_LOG_DEFAULT_LEVEL_INFO=y
```

## esp32s3_rylr896_ulp_lora/sdkconfig.defaults
```kconfig
# sdkconfig.defaults — ESP-IDF v5.4.1, target esp32s3

# Target chip
CONFIG_IDF_TARGET="esp32s3"

# ULP RISC-V coprocessor
# In v5.4.1 the prefix is ULP_COPROC_* (not ESP32S3_ULP_COPROC_*)
CONFIG_ULP_COPROC_ENABLED=y
CONFIG_ULP_COPROC_TYPE_RISCV=y
CONFIG_ULP_COPROC_RESERVE_MEM=4096

# Disable Bluetooth to save power
CONFIG_BT_ENABLED=n

# Log level: warnings only to minimise active CPU time on UART
CONFIG_LOG_DEFAULT_LEVEL_WARN=y
CONFIG_LOG_DEFAULT_LEVEL=2
CONFIG_BOOTLOADER_LOG_LEVEL_WARN=y
CONFIG_BOOTLOADER_LOG_LEVEL=2

# Console
CONFIG_ESP_CONSOLE_UART_NUM=0

# Flash speed
CONFIG_ESPTOOLPY_FLASHFREQ_80M=y
```

## esp32s3_secure_littlefs/sdkconfig.defaults
```kconfig
CONFIG_IDF_TARGET="esp32s3"
CONFIG_PARTITION_TABLE_CUSTOM=y
CONFIG_PARTITION_TABLE_CUSTOM_FILENAME="partitions.csv"
CONFIG_PARTITION_TABLE_FILENAME="partitions.csv"
CONFIG_ESPTOOLPY_FLASHSIZE_8MB=y
CONFIG_ESPTOOLPY_FLASHSIZE="8MB"
CONFIG_COMPILER_OPTIMIZATION_SIZE=y
CONFIG_LOG_DEFAULT_LEVEL_INFO=y
CONFIG_ESP_MAIN_TASK_STACK_SIZE=6144
```

## esp32s3_usb_macro_pad/sdkconfig.defaults
```kconfig
# ESP32-S3 USB HID macro pad defaults.
CONFIG_TINYUSB_HID_COUNT=1
CONFIG_ESP_CONSOLE_UART_DEFAULT=y
```

## esp32s3_usb_msc_storage_demo/sdkconfig.defaults
```kconfig
CONFIG_IDF_TARGET="esp32s3"
CONFIG_PARTITION_TABLE_CUSTOM=y
CONFIG_PARTITION_TABLE_CUSTOM_FILENAME="partitions.csv"
CONFIG_PARTITION_TABLE_FILENAME="partitions.csv"
CONFIG_ESPTOOLPY_FLASHSIZE_4MB=y
CONFIG_WL_SECTOR_SIZE_512=y
CONFIG_WL_SECTOR_MODE_PERF=y
CONFIG_TINYUSB_MSC_ENABLED=y
CONFIG_ESP_CONSOLE_UART_DEFAULT=y
CONFIG_ESP_CONSOLE_SECONDARY_NONE=y
```

## freertos_task_mastery/sdkconfig.defaults
```kconfig
CONFIG_FREERTOS_USE_TRACE_FACILITY=y
CONFIG_FREERTOS_GENERATE_RUN_TIME_STATS=y
CONFIG_FREERTOS_USE_STATS_FORMATTING_FUNCTIONS=y
CONFIG_FREERTOS_CHECK_STACKOVERFLOW_CANARY=y
CONFIG_ESP_TASK_WDT_EN=y
CONFIG_ESP_TASK_WDT_INIT=y
CONFIG_ESP_TASK_WDT_TIMEOUT_S=5
CONFIG_LOG_DEFAULT_LEVEL_INFO=y
```
