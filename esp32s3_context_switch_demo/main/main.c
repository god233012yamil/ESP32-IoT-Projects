#include <stdint.h>
#include <stdbool.h>
#include <string.h>

#include "driver/gpio.h"
#include "driver/gptimer.h"
#include "esp_check.h"
#include "esp_err.h"
#include "esp_log.h"
#include "esp_timer.h"
#include "freertos/FreeRTOS.h"
#include "freertos/queue.h"
#include "freertos/semphr.h"
#include "freertos/task.h"

#define CONTROL_TASK_PRIORITY      5
#define COMMS_TASK_PRIORITY        3
#define LOGGER_TASK_PRIORITY       2
#define MONITOR_TASK_PRIORITY      1
#define BACKGROUND_TASK_PRIORITY   1

#define CONTROL_TASK_STACK_BYTES      3072
#define COMMS_TASK_STACK_BYTES        3072
#define LOGGER_TASK_STACK_BYTES       4096
#define MONITOR_TASK_STACK_BYTES      3072
#define BACKGROUND_TASK_STACK_BYTES   3072

#define EVENT_QUEUE_LENGTH 16
#define CPU_WORK_ITERATIONS 350U

static const char *TAG = "ctx_switch_demo";

typedef enum
{
    DEMO_EVENT_CONTROL_TICK = 0,
    DEMO_EVENT_COMMAND_FRAME,
    DEMO_EVENT_BACKGROUND_HEARTBEAT
} demo_event_type_t;

typedef struct
{
    demo_event_type_t type;
    int64_t timestamp_us;
    uint32_t sequence;
    int32_t value;
    char source[16];
} demo_event_t;

static QueueHandle_t g_event_queue;
static SemaphoreHandle_t g_log_mutex;
static TaskHandle_t g_control_task_handle;
static TaskHandle_t g_comms_task_handle;
static TaskHandle_t g_logger_task_handle;
static TaskHandle_t g_monitor_task_handle;
static TaskHandle_t g_background_task_handle;
static gptimer_handle_t g_control_timer;

/**
 * @brief Enters a logging critical region using a FreeRTOS mutex.
 *
 * Args:
 *     None.
 *
 * Returns:
 *     None.
 */
static void log_lock(void)
{
    if (g_log_mutex != NULL)
    {
        (void)xSemaphoreTake(g_log_mutex, portMAX_DELAY);
    }
}

/**
 * @brief Leaves a logging critical region.
 *
 * Args:
 *     None.
 *
 * Returns:
 *     None.
 */
static void log_unlock(void)
{
    if (g_log_mutex != NULL)
    {
        (void)xSemaphoreGive(g_log_mutex);
    }
}

/**
 * @brief Configures all GPIO pins used as task execution trace outputs.
 *
 * Args:
 *     None.
 *
 * Returns:
 *     ESP_OK if all GPIO pins were configured successfully, otherwise an ESP-IDF error code.
 */
static esp_err_t configure_trace_gpio(void)
{
    gpio_config_t io_config = {
        .pin_bit_mask = (1ULL << CONFIG_DEMO_GPIO_CONTROL_TRACE) |
                        (1ULL << CONFIG_DEMO_GPIO_COMMS_TRACE) |
                        (1ULL << CONFIG_DEMO_GPIO_BACKGROUND_TRACE),
        .mode = GPIO_MODE_OUTPUT,
        .pull_up_en = GPIO_PULLUP_DISABLE,
        .pull_down_en = GPIO_PULLDOWN_DISABLE,
        .intr_type = GPIO_INTR_DISABLE,
    };

    ESP_RETURN_ON_ERROR(gpio_config(&io_config), TAG, "Failed to configure trace GPIO pins");

    gpio_set_level(CONFIG_DEMO_GPIO_CONTROL_TRACE, 0);
    gpio_set_level(CONFIG_DEMO_GPIO_COMMS_TRACE, 0);
    gpio_set_level(CONFIG_DEMO_GPIO_BACKGROUND_TRACE, 0);

    return ESP_OK;
}

/**
 * @brief Simulates a small amount of deterministic CPU work.
 *
 * Args:
 *     seed: Initial value used by the synthetic workload.
 *
 * Returns:
 *     A calculated value that prevents the compiler from removing the workload.
 */
static uint32_t run_synthetic_workload(uint32_t seed)
{
    uint32_t value = seed;

    for (uint32_t i = 0; i < CPU_WORK_ITERATIONS; i++)
    {
        value = (value * 1664525UL) + 1013904223UL;
        value ^= (value >> 13);
    }

    return value;
}

/**
 * @brief Posts a demo event to the logger queue without blocking the caller.
 *
 * Args:
 *     type: Event category.
 *     source: Short source name copied into the event payload.
 *     sequence: Monotonic event sequence number generated by the caller.
 *     value: Event-specific numeric value.
 *
 * Returns:
 *     true if the event was queued, false if the queue was full.
 */
static bool post_event(demo_event_type_t type, const char *source, uint32_t sequence, int32_t value)
{
    demo_event_t event = {
        .type = type,
        .timestamp_us = esp_timer_get_time(),
        .sequence = sequence,
        .value = value,
    };

    (void)strlcpy(event.source, source, sizeof(event.source));

    return xQueueSend(g_event_queue, &event, 0) == pdPASS;
}

/**
 * @brief Converts a demo event type into a printable string.
 *
 * Args:
 *     type: Event type to convert.
 *
 * Returns:
 *     Constant string describing the event type.
 */
static const char *event_type_to_string(demo_event_type_t type)
{
    switch (type)
    {
        case DEMO_EVENT_CONTROL_TICK:
            return "control_tick";

        case DEMO_EVENT_COMMAND_FRAME:
            return "command_frame";

        case DEMO_EVENT_BACKGROUND_HEARTBEAT:
            return "background_heartbeat";

        default:
            return "unknown";
    }
}

/**
 * @brief GPTimer alarm callback that wakes the high-priority control task.
 *
 * Args:
 *     timer: GPTimer handle that generated the alarm.
 *     edata: Alarm event metadata provided by the ESP-IDF driver.
 *     user_ctx: Optional user context pointer.
 *
 * Returns:
 *     true when a higher-priority task was woken and a yield is required.
 */
static bool IRAM_ATTR control_timer_callback(gptimer_handle_t timer,
                                             const gptimer_alarm_event_data_t *edata,
                                             void *user_ctx)
{
    BaseType_t higher_priority_task_woken = pdFALSE;

    (void)timer;
    (void)edata;
    (void)user_ctx;

    if (g_control_task_handle != NULL)
    {
        vTaskNotifyGiveFromISR(g_control_task_handle, &higher_priority_task_woken);
    }

    return higher_priority_task_woken == pdTRUE;
}

/**
 * @brief Configures and starts the hardware timer used to drive the control task.
 *
 * Args:
 *     None.
 *
 * Returns:
 *     ESP_OK if the timer was created and started successfully, otherwise an ESP-IDF error code.
 */
static esp_err_t start_control_timer(void)
{
    // Create a GPTimer instance with default configuration
    gptimer_config_t timer_config = {
        .clk_src = GPTIMER_CLK_SRC_DEFAULT,
        .direction = GPTIMER_COUNT_UP,
        .resolution_hz = 1000000,
    };
    ESP_RETURN_ON_ERROR(gptimer_new_timer(&timer_config, &g_control_timer), TAG, "Failed to create GPTimer");

    // Register the alarm callback for the control timer
    gptimer_event_callbacks_t callbacks = {
        .on_alarm = control_timer_callback,
    };
    ESP_RETURN_ON_ERROR(gptimer_register_event_callbacks(g_control_timer, &callbacks, NULL), TAG, "Failed to register GPTimer callback");

    // Configure the alarm settings for the control timer
    gptimer_alarm_config_t alarm_config = {
        .alarm_count = CONFIG_DEMO_CONTROL_PERIOD_US,
        .reload_count = 0,
        .flags.auto_reload_on_alarm = true,
    };

    // Set the alarm action and start the timer
    ESP_RETURN_ON_ERROR(gptimer_set_alarm_action(g_control_timer, &alarm_config), TAG, "Failed to set GPTimer alarm");
    ESP_RETURN_ON_ERROR(gptimer_enable(g_control_timer), TAG, "Failed to enable GPTimer");
    ESP_RETURN_ON_ERROR(gptimer_start(g_control_timer), TAG, "Failed to start GPTimer");

    return ESP_OK;
}

/**
 * @brief High-priority task woken periodically by a hardware timer interrupt.
 *
 * Args:
 *     argument: Optional task argument, unused by this task.
 *
 * Returns:
 *     None. FreeRTOS tasks do not return.
 */
static void control_task(void *argument)
{
    uint32_t sequence = 0;

    (void)argument;

    while (true)
    {
        (void)ulTaskNotifyTake(pdTRUE, portMAX_DELAY);

        gpio_set_level(CONFIG_DEMO_GPIO_CONTROL_TRACE, 1);

        uint32_t workload_result = run_synthetic_workload(sequence + 1U);

        if ((sequence % 25U) == 0U)
        {
            (void)post_event(DEMO_EVENT_CONTROL_TICK,
                             "control",
                             sequence,
                             (int32_t)(workload_result & 0x7FFFFFFFUL));
        }

        gpio_set_level(CONFIG_DEMO_GPIO_CONTROL_TRACE, 0);
        sequence++;
    }
}

/**
 * @brief Medium-priority task that simulates communication frames becoming available.
 *
 * Args:
 *     argument: Optional task argument, unused by this task.
 *
 * Returns:
 *     None. FreeRTOS tasks do not return.
 */
static void comms_task(void *argument)
{
    uint32_t sequence = 0;

    (void)argument;

    while (true)
    {
        gpio_set_level(CONFIG_DEMO_GPIO_COMMS_TRACE, 1);

        // Run a small amount of synthetic CPU work to simulate processing a communication frame
        uint32_t payload = run_synthetic_workload(sequence + 1000U);
        (void)post_event(DEMO_EVENT_COMMAND_FRAME,
                         "comms",
                         sequence,
                         (int32_t)(payload & 0xFFFFU));

        gpio_set_level(CONFIG_DEMO_GPIO_COMMS_TRACE, 0);

        sequence++;
        vTaskDelay(pdMS_TO_TICKS(250));
    }
}

/**
 * @brief Low-priority task that represents noncritical background processing.
 *
 * Args:
 *     argument: Optional task argument, unused by this task.
 *
 * Returns:
 *     None. FreeRTOS tasks do not return.
 */
static void background_task(void *argument)
{
    uint32_t sequence = 0;
    int level = 0;

    (void)argument;

    while (true)
    {
        level = !level;
        gpio_set_level(CONFIG_DEMO_GPIO_BACKGROUND_TRACE, level);

        // Run a small amount of synthetic CPU work to simulate background processing
        (void)run_synthetic_workload(sequence + 2000U);
        (void)post_event(DEMO_EVENT_BACKGROUND_HEARTBEAT,
                         "background",
                         sequence,
                         level);

        sequence++;
        vTaskDelay(pdMS_TO_TICKS(1000));
    }
}

/**
 * @brief Logger task that serializes event printing through a mutex-protected log path.
 *
 * Args:
 *     argument: Optional task argument, unused by this task.
 *
 * Returns:
 *     None. FreeRTOS tasks do not return.
 */
static void logger_task(void *argument)
{
    demo_event_t event;

    (void)argument;

    while (true)
    {
        // Wait indefinitely for an event to be posted to the logger queue
        if (xQueueReceive(g_event_queue, &event, portMAX_DELAY) == pdPASS)
        {
            log_lock();
            ESP_LOGI(TAG,
                     "event=%s source=%s seq=%lu value=%ld time_us=%lld",
                     event_type_to_string(event.type),
                     event.source,
                     (unsigned long)event.sequence,
                     (long)event.value,
                     (long long)event.timestamp_us);
            log_unlock();
        }
    }
}

/**
 * @brief Prints FreeRTOS stack high-water marks for the demo tasks.
 *
 * Args:
 *     argument: Optional task argument, unused by this task.
 *
 * Returns:
 *     None. FreeRTOS tasks do not return.
 */
static void monitor_task(void *argument)
{
    (void)argument;

    while (true)
    {
        vTaskDelay(pdMS_TO_TICKS(5000));

        log_lock();
        ESP_LOGI(TAG,
                 "stack_hwm_bytes control=%u comms=%u logger=%u monitor=%u background=%u",
                 (unsigned int)uxTaskGetStackHighWaterMark(g_control_task_handle),
                 (unsigned int)uxTaskGetStackHighWaterMark(g_comms_task_handle),
                 (unsigned int)uxTaskGetStackHighWaterMark(g_logger_task_handle),
                 (unsigned int)uxTaskGetStackHighWaterMark(g_monitor_task_handle),
                 (unsigned int)uxTaskGetStackHighWaterMark(g_background_task_handle));
        log_unlock();
    }
}

/**
 * @brief Creates all FreeRTOS synchronization objects used by the demo.
 *
 * Args:
 *     None.
 *
 * Returns:
 *     ESP_OK if all objects were created successfully, otherwise ESP_ERR_NO_MEM.
 */
static esp_err_t create_rtos_objects(void)
{
    g_event_queue = xQueueCreate(EVENT_QUEUE_LENGTH, sizeof(demo_event_t));
    if (g_event_queue == NULL)
    {
        return ESP_ERR_NO_MEM;
    }

    g_log_mutex = xSemaphoreCreateMutex();
    if (g_log_mutex == NULL)
    {
        return ESP_ERR_NO_MEM;
    }

    return ESP_OK;
}

/**
 * @brief Creates all application tasks used by the context-switching demo.
 *
 * Args:
 *     None.
 *
 * Returns:
 *     ESP_OK if all tasks were created successfully, otherwise ESP_ERR_NO_MEM.
 */
static esp_err_t create_demo_tasks(void)
{
    BaseType_t result;

    result = xTaskCreate(control_task,
                         "control_task",
                         CONTROL_TASK_STACK_BYTES,
                         NULL,
                         CONTROL_TASK_PRIORITY,
                         &g_control_task_handle);
    if (result != pdPASS)
    {
        return ESP_ERR_NO_MEM;
    }

    result = xTaskCreate(comms_task,
                         "comms_task",
                         COMMS_TASK_STACK_BYTES,
                         NULL,
                         COMMS_TASK_PRIORITY,
                         &g_comms_task_handle);
    if (result != pdPASS)
    {
        return ESP_ERR_NO_MEM;
    }

    result = xTaskCreate(logger_task,
                         "logger_task",
                         LOGGER_TASK_STACK_BYTES,
                         NULL,
                         LOGGER_TASK_PRIORITY,
                         &g_logger_task_handle);
    if (result != pdPASS)
    {
        return ESP_ERR_NO_MEM;
    }

    result = xTaskCreate(monitor_task,
                         "monitor_task",
                         MONITOR_TASK_STACK_BYTES,
                         NULL,
                         MONITOR_TASK_PRIORITY,
                         &g_monitor_task_handle);
    if (result != pdPASS)
    {
        return ESP_ERR_NO_MEM;
    }

    result = xTaskCreate(background_task,
                         "background_task",
                         BACKGROUND_TASK_STACK_BYTES,
                         NULL,
                         BACKGROUND_TASK_PRIORITY,
                         &g_background_task_handle);
    if (result != pdPASS)
    {
        return ESP_ERR_NO_MEM;
    }

    return ESP_OK;
}

/**
 * @brief ESP-IDF application entry point.
 *
 * Args:
 *     None.
 *
 * Returns:
 *     None.
 */
void app_main(void)
{
    // Configure GPIO pins used for task execution tracing
    ESP_ERROR_CHECK(configure_trace_gpio());
    
    // Create FreeRTOS synchronization objects (queue and mutex)
    ESP_ERROR_CHECK(create_rtos_objects());
    
    // Create all demo tasks (control, comms, logger, monitor, background)
    ESP_ERROR_CHECK(create_demo_tasks());
    
    // Start the hardware timer that drives the control task
    ESP_ERROR_CHECK(start_control_timer());

    // Log startup information
    log_lock();
    ESP_LOGI(TAG, "ESP32-S3 context switching demo started");
    ESP_LOGI(TAG,
             "trace_pins control=GPIO%d comms=GPIO%d background=GPIO%d period_us=%d",
             CONFIG_DEMO_GPIO_CONTROL_TRACE,
             CONFIG_DEMO_GPIO_COMMS_TRACE,
             CONFIG_DEMO_GPIO_BACKGROUND_TRACE,
             CONFIG_DEMO_CONTROL_PERIOD_US);
    log_unlock();
}
